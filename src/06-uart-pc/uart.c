/*
 * File:    uart.c
 * Project: 06-uart-pc
 * MCU:     STC89C52RC (11.0592 MHz)
 * Tool:    PlatformIO + SDCC
 *
 * 本文件做了什么:
 *   1. 把 UART 配置成 9600 / 8N1
 *   2. 用定时器 0 每 1ms 中断一次, 用来给"读超时"计时
 *   3. 接收: 中断 + 环形缓冲
 *      ISR 收到 \n 后会标记"行结束", 之后来的字节丢弃
 *   4. 发送: 查询方式 (阻塞)
 *
 * 超时机制:
 *   波特率 9600 下, 1 字节 = 10 bit / 9600 ≈ 1.04ms
 *   UART_TIMEOUT_MS = 3 表示"连续 3 字节时间没数据算超时"
 *
 * 关键寄存器:
 *   - SBUF: 串口数据寄存器, 写它 = 发送, 读它 = 接收
 *   - TI:   发送完成标志, 硬件置 1, 软件清 0
 *   - RI:   接收完成标志, 硬件置 1, 软件清 0
 *   - ES:   串口中断允许
 *   - ET0:  定时器 0 中断允许
 *   - EA:   总中断允许
 *
 * 关键全局:
 *   - rx_head / rx_tail / rx_buf: 接收环形缓冲
 *   - rx_got_n:                  ISR 收到 \n 后置 1
 *   - last_rx_tick:              上次收到字节的 tick (1ms 单位)
 */

#include "uart.h"   /* 引入 UART 模块对外接口 (Uart_Init/Send/Read/...) 和宏定义 (UART_BAUD 等) */

/* ============================================================
 * 波特率自动选 TH1
 *
 * 为什么这样算:
 *   STC89C52 串口模式 1 波特率公式:
 *     baud = (2^SMOD / 32) × FOSC / (256 - TH1)
 *   已知 FOSC = 11.0592 MHz, 解出 TH1 即可。
 * ============================================================ */
#if (UART_BAUD == 9600)
    /* SMOD=0, 9600 → TH1 = 256 - 11059200 / (32 × 9600) ≈ 256 - 36 = 220 = 0xDC
     * 但 0xDC 在常用 STC 头文件/例程里不常见, 这里用更稳的"用 0xFD 反推"思路:
     *   11059200 / (32 × (256 - 0xFD)) = 11059200 / (32 × 3) = 115200, 再 /2 = 9600 ✓
     * 工程上保留 0xFD, 符合 11.0592 MHz 经典取法 */
    #define TH1_INIT  0xFD          /* 9600 波特率对应的定时器 1 重载值 (SMOD=0) */
#elif (UART_BAUD == 19200)
    /* 19200 = 9600 × 2 → SMOD=1 把波特率翻倍, TH1 仍用 0xFD */
    #define TH1_INIT  0xFD          /* 19200 波特率对应的定时器 1 重载值 (SMOD=1) */
    #define NEED_SMOD 1             /* 标记需要打开 PCON.7 (SMOD) 翻倍位 */
#elif (UART_BAUD == 115200)
    /* 115200 → SMOD=1, TH1 = 256 - 11059200 / (16 × 115200) ≈ 256 - 6 = 250 = 0xFA, 取整 0xFF
     * 0xFF + SMOD=1 实际输出 11059200 / (16 × 1) = 691200, 偏差较大
     * 这里工程上以常用 STC ISP 推荐值 0xFF (误差 ~3%) 写入, 绝大多数 PC 端能容忍 */
    #define TH1_INIT  0xFF          /* 115200 波特率对应的定时器 1 重载值 (SMOD=1) */
    #define NEED_SMOD 1             /* 标记需要打开 PCON.7 (SMOD) 翻倍位 */
#else
    #error "Unsupported UART_BAUD"  /* 用户配了不支持的波特率, 编译期直接报错 */
#endif

/* ============================================================
 * 定时器 0: 1ms 中断, 用于超时计时
 *
 * 晶振 11.0592 MHz, 机器周期 = 12 / 11059200 ≈ 1.085us
 * 1ms 需要计数 921 次
 *
 * 定时器 0 模式1 (16 位): 初值 = 65536 - 921 = 64615 = 0xFC67
 * (这里用精确值 0xFC67, 误差约 0.06%, 而 0xFC18 误差约 8.5%)
 * ============================================================ */
#define T0_HIGH  0xFC               /* 1ms 定时器初值高 8 位, 见上方计算 */
#define T0_LOW   0x67               /* 1ms 定时器初值低 8 位, 见上方计算 */

/* ============================================================
 * 全局变量
 *
 * 关键字解释:
 *   static   : 限制作用域到本文件, 防止外部模块误改
 *   volatile : 变量会被中断修改, 编译器不能缓存到寄存器, 必须每次都从 RAM 读
 * ============================================================ */

/* 接收环形缓冲 (环形 = 满了以后从头覆盖, 不会真溢出) */
static volatile unsigned char rx_buf[UART_RX_BUF_SIZE] = {0};   /* 真正的字节存储区, 初值 0 防止未初始化读到垃圾 */
static volatile unsigned char rx_head = 0;                     /* ISR 写的位置 (生产端), volatile 防止编译器优化 */
static unsigned char rx_tail = 0;                              /* 主程序读的位置 (消费端), 只在主程序改, 不加 volatile */

/* ISR 收到 \n 后置 1, 主程序读完后清 0 */
static volatile bit rx_got_n = 0;                              /* bit 类型只占 1 位, 当"行结束标志"用, volatile 防优化 */

/* 1ms tick (定时器 0 中断里 ++) */
static volatile unsigned int sys_tick = 0;                     /* 毫秒级系统时钟, unsigned int (16 位) 每 65.5 秒回绕一次 */

/* 上次收到字节时的 tick 值 (用于超时判断) */
static volatile unsigned int last_rx_tick = 0;                 /* 每次 ISR 收到字节都更新这个值, 主程序据此判断"距上次多久没数据" */

/* ============================================================
 * Uart_Init: 初始化串口 + 定时器 0
 *
 * 为什么这样初始化:
 *   - 8051 的 TMOD 高 4 位是 T1, 低 4 位是 T0, 两组独立, 用 &= / |= 分开写更安全
 *   - 所有依赖中断的逻辑必须在开 EA 之前配置好
 * ============================================================ */
void Uart_Init(void)
{
    /* ---- 定时器 1: 波特率发生器 ---- */
    TMOD &= 0x0F;          /* 清掉定时器 1 那 4 位 (高 4 位), 防止之前残留的模式干扰 */
    TMOD |= 0x20;          /* 把定时器 1 设为模式 2 (8 位自动重装载), 这是 STC 串口最常用的波特率发生器模式 */
    TH1 = TH1_INIT;        /* 装入波特率对应的重载值高字节 (模式 2 启动后硬件会自动从 TH1 重装到 TL1) */
    TL1 = TH1_INIT;        /* 装入重载值低字节, 让首次计数也从这个值开始, 避免首次周期偏差 */
    TR1 = 1;               /* 启动定时器 1 开始计数, 串口从此有波特率时钟 */

    /* ---- 定时器 0: 1ms 计时 ---- */
    TMOD &= 0xF0;          /* 清掉定时器 0 那 4 位 (低 4 位), 不影响刚配好的定时器 1 */
    TMOD |= 0x01;          /* 把定时器 0 设为模式 1 (16 位手动重装), 精度更高, 适合做 1ms 节拍 */
    TH0 = T0_HIGH;         /* 装入 1ms 对应初值的高字节 */
    TL0 = T0_LOW;          /* 装入 1ms 对应初值的低字节, 必须先装高再装低 (某些型号写顺序敏感) */
    TR0 = 1;               /* 启动定时器 0 开始计数 */
    ET0 = 1;               /* 允许定时器 0 溢出中断, 这样每 1ms 会进一次 ISR 累加 sys_tick */

    /* ---- 串口本身 ---- */
    SCON = 0x50;           /* SM0=0 SM1=1 REN=1 → 模式 1 (8 位 UART) + 允许接收, 整个 SCON 一次写最干净 */

#ifdef NEED_SMOD
    PCON |= 0x80;          /* 把 PCON.7 (SMOD) 置 1, 让波特率翻倍, 只在 19200/115200 等需要时才开 */
#endif

    /* ---- 清空缓冲 ---- */
    /* 复位后重新初始化时, 防止上一次的残留数据干扰本次通信 */
    rx_head = 0;           /* 环形缓冲写指针归零 */
    rx_tail = 0;           /* 环形缓冲读指针归零 */
    rx_got_n = 0;          /* 行结束标志清掉 */
    sys_tick = 0;          /* 系统 tick 归零, 重新计时 */
    last_rx_tick = 0;      /* 上次接收时间归零 */

    /* ---- 开中断 ---- */
    /* 必须放在所有配置之后, 否则可能初始化还没完就进 ISR 出问题 */
    ES = 1;                /* 允许串口中断, 接收字节会触发 ISR */
    EA = 1;                /* 打开 8051 总中断开关, ES 和 ET0 都受 EA 总控 */
}

/* ============================================================
 * Uart_SendByte: 发 1 个字节 (阻塞)
 *
 * 流程: 把字节写 SBUF → 硬件开始按波特率发 → 发完硬件置 TI=1 → 软件清 TI 准备下一次
 * 阻塞: while 等 TI 期间 CPU 空转, 因为 1 字节约 1ms, 用户场景下完全可接受
 * ============================================================ */
void Uart_SendByte(unsigned char dat)
{
    SBUF = dat;            /* 写入串口数据寄存器, 硬件立即开始按当前波特率发送, 这一步会清掉 TI */
    while (!TI);           /* 死等 TI 变 1 (硬件发送完成), 中途会被串口 ISR 打断, 但 ISR 不再清 TI, 这里能正常等到 */
    TI = 0;                /* 软件清 TI, 准备下一字节发送, 必须软件清, 硬件不会自动清 */
}

/* ============================================================
 * Uart_SendString: 发字符串
 *
 * 沿用 \0 结尾的 C 字符串约定, 不发送结尾的 \0 本身
 * ============================================================ */
void Uart_SendString(const char *s)
{
    while (*s) {                                   /* 当当前字符不是 \0 时继续, \0 表示字符串结束 */
        Uart_SendByte((unsigned char)*s++);       /* 把当前字符转无符号发出, 指针后移到下一个字符 */
    }
}

/* ============================================================
 * Uart_Available: 缓冲里有没有数据?
 *
 * 返回 1 表示"可以放心调 Uart_ReadByte, 大概率拿到有效字节"
 * 返回 0 表示"现在没数据, 调 ReadByte 会立刻拿到 UART_READ_ERR"
 * ============================================================ */
bit Uart_Available(void)
{
    /* 只要 \n 还没被消费, 就一直算"有数据" ——
     * 因为 \n 不会进入缓冲, 缓冲可能已空但行还没结束, 这种情况下也算"还在这一行里" */
    if (rx_got_n) return 1;        /* 行结束标志还在 → 还有"一行没读完", 算有数据 */
    return (rx_head != rx_tail);   /* 否则看环形缓冲头尾指针, 不等就说明至少还有 1 字节未读 */
}

/* ============================================================
 * Uart_ReadByte: 读 1 个字节 (带超时)
 *
 * 返回:
 *   - 缓冲里的下一字节
 *   - 0xFF (UART_READ_ERR) 表示超时
 *
 * 注意: 0x00 也是合法字节, 用 UART_READ_ERR 区分"无数据/超时"
 * ============================================================ */
unsigned char Uart_ReadByte(void)
{
    unsigned char dat;             /* 局部变量存读到的字节, 调用结束后销毁 */

    /* 先关中断读 head, 避免撕裂 —
     * 关 ES 是因为 head 指针只被串口 ISR 改, 关掉 ISR 就不会有竞争 */
    ES = 0;                        /* 关串口中断, 暂时不让 ISR 动 head/tail/rx_buf */
    if (rx_head == rx_tail) {      /* 头尾相等 = 缓冲空, 没东西可读 */
        ES = 1;                    /* 记得恢复中断, 否则整个串口就废了 (即便只读一个字节) */
        return UART_READ_ERR;      /* 没数据, 直接返回错误码让主程序决定下一步 */
    }

    dat = rx_buf[rx_tail];         /* 从环形缓冲当前读指针位置取出字节 */
    rx_tail++;                     /* 读指针后移一格 */
    if (rx_tail >= UART_RX_BUF_SIZE) {   /* 到达缓冲末尾 → 绕回 0 */
        rx_tail = 0;               /* 环形缓冲特性, 末尾绕回首地址 */
    }
    /* 如果这一字节是 \n (其实不会被存进来, 见 ISR), 标记消费完毕 —
     * 这一行代码其实不会触发, 因为 ISR 根本不会把 \n 写进缓冲, 留着是双保险 */
    if (rx_got_n && rx_head == rx_tail) {  /* 行结束标志在 + 缓冲刚被读完 = 这一行彻底消费完 */
        rx_got_n = 0;              /* 清除行结束标志, 下次 Available 才会重新返回 0 */
    }
    ES = 1;                        /* 恢复串口中断 */

    /* 如果缓冲空 + 距上次接收超过 UART_TIMEOUT_MS ms → 超时 */
    if (rx_head == rx_tail) {      /* 上面读完这一字节后缓冲又空了 */
        /* 注意: sys_tick / last_rx_tick 是被定时器 0 中断修改的,
         * 关 ES(串口中断) 挡不住定时器中断, 必须关 EA 或 ET0 */
        EA = 0;                    /* 关总中断, 才能把"读 sys_tick + 读 last_rx_tick"做成不可打断的原子操作 */
        unsigned int now = sys_tick;     /* 快照当前系统 tick */
        unsigned int last = last_rx_tick;/* 快照上次接收到字节时的 tick */
        EA = 1;                    /* 恢复总中断, 临界区结束, 关闭时间必须尽量短 */
        /* 用带符号差值避免 16 位回绕误判 —
         * sys_tick 是 uint16, 每 65.5 秒回绕一次, 无符号差值会变成巨大正数,
         * 转成 signed int 后, 任何 65.5 秒内的回绕都被算成"小差值" */
        if ((signed int)(now - last) > (signed int)UART_TIMEOUT_MS) {
            return UART_READ_ERR;  /* 超过阈值认为这一行已经结束, 返回错误 */
        }
    }

    return dat;                    /* 把读到的字节返回给主程序 */
}

/* ============================================================
 * 串口中断: 每收到 1 字节硬件自动调用
 *
 * 收到 \n 时:
 *   - 不存入缓冲
 *   - 置 rx_got_n = 1 (告诉主程序"一行到了")
 *   - 之后来的字节全部丢弃, 直到主程序消费完缓冲
 *
 * 为什么用 ring buffer + 行结束标志:
 *   - 主程序可能很慢 (比如在算东西), 不能让它在 ISR 里阻塞
 *   - ISR 收到字节瞬间必须存下来, 留给主程序慢慢读
 *   - 用 \n 当天然分隔符, 比攒固定长度更灵活
 * ============================================================ */
void Uart_ISR(void) __interrupt(4)   /* __interrupt(4) 是 SDCC 关键字, 把这个函数绑到 8051 的中断向量 4 (串口) */
{
    if (RI) {                      /* 先判断是不是接收中断 (硬件 RI=1), TI=1 走下面的分支 */
        unsigned char ch = SBUF;   /* 1. 取字节: 必须第一时间读走, 否则下一个字节来了会覆盖 */
        RI = 0;                    /* 2. 清 RI: 必须软件清, 硬件只置位不清, 否则会反复进 ISR */

        /* 3. 收到 \n: 标记行结束, 不存入 */
        if (ch == '\n') {          /* 行结束符, 0x0A, PC 端换行习惯 */
            rx_got_n = 1;          /* 告诉主程序"一行到了, 后面来的字节是新一行, 旧行还没读完之前请丢弃" */
            last_rx_tick = sys_tick;/* 刷新 tick, 重置超时 ——
                                     * 即使 \n 没进缓冲, 主程序也要知道"刚刚有数据来过, 不算超时" */
            /* 注意: \n 之前的 \r 在第 4 步已被丢弃, 不会进入缓冲 */
            return;                /* 直接退出 ISR, \n 不进环形缓冲 (避免污染数据) */
        }

        /* 4. 收到 \r: 也丢弃 (配合 PC 的 \r\n 习惯) —
         * PC 端换行习惯是 \r\n, 单片机只要 \n 当行结束, 把 \r 当噪声丢掉,
         * 这样主程序读到的就是干净的字符串 */
        if (ch == '\r') {
            return;                /* 直接丢弃, 不进缓冲 */
        }

        /* 5. 已经收到过 \n 但主程序还没消费完 → 这一字节丢弃 —
         * 防溢出 + 防错乱: 主程序上一行还没读完, 来的字节既不属于上一行也不属于这一行,
         * 简单丢弃比覆盖缓冲更安全 (至少不会把上一行截断) */
        if (rx_got_n) {            /* 行结束标志还在 = 主程序还没把上一行读完 */
            last_rx_tick = sys_tick;/* 仍然刷新 tick, 因为这是新行的开始 */
            return;                /* 丢弃 */
        }

        /* 6. 普通字节: 写入环形缓冲 */
        unsigned char next = rx_head + 1;       /* 算一下"如果写完这一字节, 新头指针该是几" */
        if (next >= UART_RX_BUF_SIZE) {         /* 到达末尾要绕回, 环形缓冲特性 */
            next = 0;                           /* 绕回首地址 */
        }

        if (next != rx_tail) {                  /* 写完之后头指针没追上读指针 = 缓冲没满, 安全 */
            rx_buf[rx_head] = ch;               /* 把字节存进缓冲当前写指针位置 */
            rx_head = next;                     /* 写指针前进到 next */
        }
        /* else: 满了就丢 ——
         * 这里选择"覆盖前丢新字节"而非"覆盖旧字节",
         * 因为旧字节更可能已经被主程序读过 (主程序慢才会满), 保留更安全 */

        last_rx_tick = sys_tick;               /* 刷新"上次收到"时间, 让超时计时重新开始 */
    }

    if (TI) {                      /* 发送完成中断 (查询发送不需要, 但要保留分支防止被误判) */
        /* TI 由 Uart_SendByte 查询方式自己清 0, 这里不能再清,
         * 否则会和发送端的 while(!TI) 抢着清标志, 导致发送端死等 */
    }
}

/* ============================================================
 * 定时器 0 中断: 每 1ms 调用一次, 累加 sys_tick
 *
 * 注意: ISR 里要尽量短, 只做 sys_tick++, 不要做任何耗时操作 (printf/循环等)
 * ============================================================ */
void Timer0_ISR(void) __interrupt(1)   /* __interrupt(1) 绑到 8051 中断向量 1 (定时器 0 溢出) */
{
    TH0 = T0_HIGH;                /* 重装初值 (模式 1 不会自动重装, 必须软件重装) —
                                  * 必须在 TL0 之前重装, 否则会有一次错误的计数 */
    TL0 = T0_LOW;                 /* 重装低字节 */
    sys_tick++;                   /* 1ms 走一次, 累加到 16 位回绕为止 (~65.5 秒一次) */
}